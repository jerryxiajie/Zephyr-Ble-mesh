## basic_src_cli_02/light2_server/sample.yaml
```yaml
sample:
  name: Bluetooth Mesh Server
tests:
  test:
    harness: bluetooth
    platform_whitelist: bbc_microbit nrf51_blenano qemu_x86
    tags: bluetooth
```
